/dts-v1/;
/plugin/;

/{ 
  compatible = "ti,beaglebone", "ti,beaglebone-black";
  part-number = "I2C1"; 
  version = "00A0";

  exclusive-use =
	"P9.18", 
	"P9.17", 

	"i2c1";

  fragment@0 {
    target = <&am33xx_pinmux>; 

    __overlay__ {
      i2c1_pins: pinmux_i2c1_pins {
        pinctrl-single,pins = <
          0x158 0x72 	// I2C1 SDA  
          0x15C 0x72 	// I2C1 SCL 
        >;
      };
    };
  };

  fragment@1 {
    target = <&i2c1>;

    __overlay__ {
      status = "okay";
      pinctrl-names = "default";
      pinctrl-0 = <&i2c1_pins>;

      clock-frequency = <100000>;

      #address-cells = <1>;
      #size-cells = <0>;
    };
  };
};
